## conf/layer.conf
```bitbake
# We have a conf and classes directory, add to BBPATH
BBPATH .= ":${LAYERDIR}"

# We have recipes-* directories, add to BBFILES
BBFILES += "${LAYERDIR}/recipes-*/*/*.bb \
            ${LAYERDIR}/recipes-*/*/*.bbappend"

BBFILE_COLLECTIONS += "nerves-hub"
BBFILE_PATTERN_nerves-hub = "^${LAYERDIR}/"
BBFILE_PRIORITY_nerves-hub = "6"

LAYERDEPENDS_nerves-hub = "core erlang-layer"
LAYERSERIES_COMPAT_nerves-hub = "whinlatter"
```
